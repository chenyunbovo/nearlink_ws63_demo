## Kconfig
```kconfig
#===============================================================================
# @brief    Kconfig file.
# Copyright (c) @CompanyNameMagicTag 2023-2023. All rights reserved.
#===============================================================================

config SAMPLE_SUPPORT_MQTT3_CLIENT_SAMPLE
    bool "Support MQTT3 Client Sample."

config SAMPLE_SUPPORT_MQTT5_CLIENT_SAMPLE
    bool "Support MQTT5 Client Sample."

config SAMPLE_SUPPORT_HTTP_SERVER_SAMPLE
    bool "Support HTTP Server Sample."

config SAMPLE_SUPPORT_HTTP_CLIENT_SAMPLE
    bool "Support HTTP Client Sample."

config SAMPLE_SUPPORT_FIX_STA_SAMPLE
    bool "Support FIX STA Sample."

config SAMPLE_SUPPORT_BLUFI_SAMPLE
    bool "Support blufi Sample."

config SAMPLE_SUPPORT_SNTP_CLIENT_SAMPLE
    bool "Support sntp client Sample."
```
